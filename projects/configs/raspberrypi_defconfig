## projects/configs/raspberrypi_defconfig
```kconfig
BR2_arm=y
BR2_arm1176jzf_s=y
BR2_ARM_EABIHF=y

BR2_SYSTEM_DHCP="eth0"

# Linux headers same as kernel, a 5.10 series
BR2_PACKAGE_HOST_LINUX_HEADERS_CUSTOM_5_10=y

BR2_LINUX_KERNEL=y
BR2_LINUX_KERNEL_CUSTOM_TARBALL=y
BR2_LINUX_KERNEL_CUSTOM_TARBALL_LOCATION="$(call github,raspberrypi,linux,581049d718caf95f5feb00607ac748d5841cf27c)/linux-581049d718caf95f5feb00607ac748d5841cf27c.tar.gz"
BR2_LINUX_KERNEL_DEFCONFIG="bcmrpi"

# Build the DTBs for A/B, A+/B+ and compute module from the kernel sources
BR2_LINUX_KERNEL_DTS_SUPPORT=y
BR2_LINUX_KERNEL_INTREE_DTS_NAME="bcm2708-rpi-b bcm2708-rpi-b-plus bcm2708-rpi-cm"

BR2_LINUX_KERNEL_NEEDS_HOST_OPENSSL=y

BR2_PACKAGE_RPI_FIRMWARE=y
BR2_PACKAGE_RPI_FIRMWARE_BOOTCODE_BIN=y
BR2_PACKAGE_RPI_FIRMWARE_VARIANT_PI=y
BR2_PACKAGE_RPI_FIRMWARE_CONFIG_FILE="$(BR2_EXTERNAL_PROJECTS_PATH)/board/raspberrypi/config_default.txt"
# BR2_PACKAGE_RPI_FIRMWARE_INSTALL_DTB_OVERLAYS is not set

# Required tools to create the SD image
BR2_PACKAGE_HOST_DOSFSTOOLS=y
BR2_PACKAGE_HOST_GENIMAGE=y
BR2_PACKAGE_HOST_MTOOLS=y
BR2_PACKAGE_HOST_E2FSPROGS=y

# Filesystem / image
BR2_TARGET_ROOTFS_EXT2=y
BR2_TARGET_ROOTFS_EXT2_4=y
BR2_TARGET_ROOTFS_EXT2_SIZE="200M"
# BR2_TARGET_ROOTFS_TAR is not set
BR2_ROOTFS_POST_IMAGE_SCRIPT="support/scripts/genimage.sh"
BR2_ROOTFS_POST_SCRIPT_ARGS="-c $(BINARIES_DIR)/genimage.cfg"

# Bootloader (u-boot)
BR2_TARGET_UBOOT=y
BR2_TARGET_UBOOT_BOARD_DEFCONFIG="rpi"
BR2_TARGET_UBOOT_CONFIG_FRAGMENT_FILES="$(BR2_EXTERNAL_PROJECTS_PATH)/board/raspberrypi/uboot-fragment.config"

# Systemd
BR2_TOOLCHAIN_BUILDROOT_GLIBC=y
BR2_INIT_SYSTEMD=y
# BR2_TARGET_GENERIC_REMOUNT_ROOTFS_RW is not set

BR2_PACKAGE_RACINE_BOOT=y
BR2_PACKAGE_RACINE_BOOT_RAUC_COMPATIBLE="racine-rpi-1"
BR2_PACKAGE_RACINE_BOOT_RAUC_VERSION="2022-01-01.1"
BR2_PACKAGE_RACINE_BOOT_BOOTARGS="console=tty1 console=ttyAMA0,115200"
BR2_PACKAGE_RACINE_BOOT_GENIMAGE_TEMPLATE="$(BR2_EXTERNAL_PROJECTS_PATH)/board/raspberrypi/genimage-raspberrypi.cfg"
BR2_PACKAGE_RACINE_BOOT_UBOOT_ENV_CONFIG_FILE="$(BR2_EXTERNAL_PROJECTS_PATH)/board/raspberrypi/fw_env.config"
BR2_PACKAGE_RACINE_BOOT_UBOOT_ENV_SIZE="0x4000"

BR2_PACKAGE_RACINE_DATA=y
```

## racine/Config.in
```kconfig
source "$BR2_EXTERNAL_RACINE_PATH/package/racine-boot/Config.in"
source "$BR2_EXTERNAL_RACINE_PATH/package/racine-data/Config.in"
```

## racine/package/racine-boot/Config.in
```kconfig
config BR2_PACKAGE_RACINE_BOOT
	bool "racine-boot"
	help
		RAUC and u-boot setup for Racine
    depends on BR2_LINUX_KERNEL
	depends on !BR2_TARGET_ROOTFS_INITRAMFS # kernel install target
    select BR2_LINUX_KERNEL_INSTALL_TARGET

	select BR2_PACKAGE_HOST_UBOOT_TOOLS
    depends on BR2_TARGET_UBOOT

	depends on BR2_TOOLCHAIN_HAS_THREADS # rauc
	depends on BR2_USE_MMU # rauc
	depends on BR2_USE_WCHAR # rauc
	select BR2_PACKAGE_RAUC
    select BR2_PACKAGE_RAUC_NETWORK
	select BR2_PACKAGE_HOST_RAUC

	depends on BR2_INIT_SYSTEMD

comment "Racine boot requires U-Boot as bootloader and systemd as init"
	depends on !(BR2_TARGET_UBOOT && BR2_INIT_SYSTEMD)

if BR2_PACKAGE_RACINE_BOOT

config BR2_PACKAGE_RACINE_BOOT_RAUC_COMPATIBLE
	string "RAUC compatible"
	help
	   RAUC compabible string

	   https://rauc.readthedocs.io/en/latest/reference.html#system-configuration-file

config BR2_PACKAGE_RACINE_BOOT_RAUC_VERSION
	string "RAUC version"
	help
	   RAUC bundle version

	   https://rauc.readthedocs.io/en/latest/reference.html#system-configuration-file

config BR2_PACKAGE_RACINE_BOOT_BOOTARGS
	string "Kernel boot arguments"
	help
	   Boot arguments for the kernel (added to the generic ones)

config BR2_PACKAGE_RACINE_BOOT_UBOOT_ENV_CONFIG_FILE
	string "U-Boot env config file path"
	help
	   Path for the U-boot fw_env.config file to use

config BR2_PACKAGE_RACINE_BOOT_UBOOT_ENV_SIZE
	string "U-Boot env image size"
	help
	   Size of the U-Boot env image (configured by CONFIG_ENV_SIZE in U-Boot config)

config BR2_PACKAGE_RACINE_BOOT_GENIMAGE_TEMPLATE
	string "Genimage temmplate"
	help
	   A genimage config template

	   The variables @RACINE_BOOT_xxxx@ will be substituted by the appropriate values


endif # BR2_PACKAGE_RACINE_BOOT
```

## racine/package/racine-data/Config.in
```kconfig
config BR2_PACKAGE_RACINE_DATA
	bool "racine-data"
	help
		Data partition and R/O rootfs for Racine

	depends on BR2_USE_MMU # e2fsprogs util-linux
    select BR2_PACKAGE_E2FSPROGS
    select BR2_PACKAGE_E2FSPROGS_RESIZE2FS
    select BR2_PACKAGE_UTIL_LINUX
    select BR2_PACKAGE_UTIL_LINUX_BINARIES # sfdisk
    select BR2_PACKAGE_UTIL_LINUX_PARTX

	depends on BR2_INIT_SYSTEMD

comment "racine-data requires systemd as init"
	depends on !BR2_INIT_SYSTEMD
```
